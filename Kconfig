## Kconfig
```kconfig
config EFI
	bool "UEFI runtime support"
	depends on MMU
	default y
	select EFI_STUB
	help
	  This option provides support for runtime services provided
	  by UEFI firmware.
```

## config/Kconfig
```kconfig
mainmenu "REMU Configuratuion Menu"

source "memory/Kconfig"

source "debug/Kconfig"

source "base/Kconfig"
```

## config/base/Kconfig
```kconfig
menu "BASE_CONFIG"

    menu "RESET_VECTOR"

    config EMU_DM_BASE_RESET_VECTOR
        hex "Set EMU DirectlyMap Reset Vector"
        default 0x80000000
        help
            Set the reset vector for the EMU DirectlyMap platform.

    config EMU_SC_BASE_RESET_VECTOR
        hex "Set EMU SingleCycle Reset Vector"
        default 0x80000000
        help
            Set the reset vector for the EMU SingleCycle platform.

    config NZEA_NPC_BASE_RESET_VECTOR
        hex "Set NZEA NPC Reset Vector"
        default 0x80000000
        help
            Set the reset vector for the NZEA platform.
            
    config NZEA_YSYXSOC_BASE_RESET_VECTOR
        hex "Set NZEA YSYXSOC Reset Vector"
        default 0x30000000
        help
            Set the reset vector for the NZEA platform.
            
    config NZEA_JydRemote_BASE_RESET_VECTOR
        hex "Set NZEA JydRemote Reset Vector"
        default 0x80000000
        help
            Set the reset vector for the NZEA platform.

    endmenu

endmenu
```

## config/debug/Kconfig
```kconfig
menu "Debugging"
    config DEBUG_RL_HISTORY_SIZE
        int "Readline History Size"
        default 1000
        help
            Size of history for readline.

    config DEBUG_DEFAULT_ITRACE_ENABLE
        bool "Default Itrace Enable"
        default n
        help
            Enable Itrace by default.
endmenu
```

## config/dynamic/Kconfig
```kconfig
mainmenu "REMU Dynamic Configuratuion Menu"

source "dynamic/region/Kconfig"

source "dynamic/debug/Kconfig"

source "dynamic/base/Kconfig"
```

## config/dynamic/base/Kconfig
```kconfig
menu "BASE_CONFIG"

    menu "RESET_VECTOR"

    config Emu_Dm_BASE_RESET_VECTOR
        hex "Set Emu DirectlyMap Reset Vector"
        default 0x80000000
        help
            Set the reset vector for the Emu DirectlyMap platform.

    config Emu_Sc_BASE_RESET_VECTOR
        hex "Set Emu SingleCycle Reset Vector"
        default 0x80000000
        help
            Set the reset vector for the Emu SingleCycle platform.

    config Nzea_Npc_BASE_RESET_VECTOR
        hex "Set Nzea Npc Reset Vector"
        default 0x80000000
        help
            Set the reset vector for the Nzea platform.
            
    config Nzea_Ysyxsoc_BASE_RESET_VECTOR
        hex "Set Nzea Ysyxsoc Reset Vector"
        default 0x30000000
        help
            Set the reset vector for the Nzea platform.
            
    config Nzea_JydRemote_BASE_RESET_VECTOR
        hex "Set Nzea JydRemote Reset Vector"
        default 0x80000000
        help
            Set the reset vector for the Nzea platform.

    endmenu

endmenu
```

## config/dynamic/cache/Kconfig
```kconfig
menu "Cache"
    source "dynamic/cache/emu/Kconfig"

    source "dynamic/cache/nzea/Kconfig"
endmenu
```

## config/dynamic/cache/emu/Kconfig
```kconfig
menu "Emu"
    config Emu_Pl_Cache_BTB
        string "Emu BTB Cache Config"
        default "16 1 1 lru"

    config Emu_Pl_Cache_ICache
        string "Emu ICache Cache Config"
        default "4 1 4 lru"

endmenu
```

## config/dynamic/cache/nzea/Kconfig
```kconfig
menu "Nzea"
    menu "Ysyxsoc Cache Config"

        config Nzea_Ysyxsoc_Cache_BTB
            string "Nzea BTB Cache Config"
            default "16 1 1 lru"

        config Nzea_Ysyxsoc_Cache_ICache
            string "Nzea ICache Cache Config"
            default "4 1 4 lru"

    endmenu

    menu "Npc Cache Config"

        config Nzea_Npc_Cache_BTB
            string "Nzea BTB Cache Config"
            default "16 1 1 lru"

        config Nzea_Npc_Cache_ICache
            string "Nzea ICache Cache Config"
            default "4 1 4 lru"

        config Nzea_Npc_Cache_DCache
            string "Nzea DCache Cache Config"
            default "4 1 4 lru"
        
    endmenu

    menu "jyd Cache Config"

        config Nzea_Jyd_Cache_BTB
            string "Nzea Jyd Cache Config"
            default "16 1 1 lru"

        config Nzea_Jyd_Cache_ICache
            string "Nzea ICache Cache Config"
            default "4 1 4 lru"
        
    endmenu

    menu "jyd remote Cache Config"

        config Nzea_JydRemote_Cache_BTB
            string "Nzea JydRemote Cache Config"
            default "16 1 1 lru"

        config Nzea_JydRemote_Cache_ICache
            string "Nzea ICache Cache Config"
            default "4 1 4 lru"
        
    endmenu

endmenu
```

## config/dynamic/debug/Kconfig
```kconfig
menu "Debugging"
    config DEBUG_RL_HISTORY_SIZE
        int "Readline History Size"
        default 1000
        help
            Size of history for readline.

    config DEBUG_DEFAULT_ITRACE_ENABLE
        bool "Default Itrace Enable"
        default n
        help
            Enable Itrace by default.

    config DEBUG_DEFAULT_WaveTRACE_ENABLE
        bool "Default Wavetrace Enable"
        default n
        help
            Enable WaveTrace by default.
endmenu
```

## config/dynamic/region/Kconfig
```kconfig
menu "Regions"
    source "dynamic/region/emu/Kconfig"

    source "dynamic/region/nzea/Kconfig"
endmenu
```

## config/dynamic/region/emu/Kconfig
```kconfig
menu "Emu Platform"
    choice
        prompt "Emu Memory Map"
        default Emu_Memory_Map_Emu_default

    config Emu_Memory_Map_Emu_default
        bool "Emu_default"

    config Emu_Memory_Map_NZEA_NPC
        bool "NZEA_NPC"

    config Emu_Memory_Map_NZEA_YSYXSOC
        bool "NZEA_YSYXSOC"
            
    endchoice

    menu "DirectlyMap Regions"

        config Emu_Dm_MEM_PSRAM
            string "Emu PSRAM Region"
            default "0x80000000 0x08000000 0b00000111"

        config Emu_Dm_MEM_SRAM
        depends on Emu_Memory_Map_NZEA_YSYXSOC
            string "Emu SRAM Region"
            default "0x0f000000 0x00002000 0b00000111"

        config Emu_Dm_MEM_MROM
        depends on Emu_Memory_Map_NZEA_YSYXSOC
            string "Emu MROM Region"
            default "0x20000000 0x00001000 0b00000101"

        config Emu_Dm_MEM_FLASH
        depends on Emu_Memory_Map_NZEA_YSYXSOC
            string "Emu FLASH Region"
            default "0x30000000 0x10000000 0b00000111"

        config Emu_Dm_MEM_SDRAM
        depends on Emu_Memory_Map_NZEA_YSYXSOC
            string "Emu SDRAM Region"
            default "0xa0000000 0x02000000 0b00000111"

        config Emu_Dm_MEM_Chip
        depends on Emu_Memory_Map_NZEA_YSYXSOC
            string "Emu Chip Region"
            default "0xc0000000 0x00020000 0b00000011"

        config Emu_Dm_DEV_Serial
            string "Emu Serial Region"
            default "0x100003f8 0x00000004 0b00000011" if Emu_Memory_Map_Emu_default
            default "0x10000000 0x00000004 0b00000011" if Emu_Memory_Map_NZEA_NPC

        config Emu_Dm_DEV_Timer
            string "Emu Timer Region"
            default "0x10000048 0x00000008 0b00000001" if Emu_Memory_Map_Emu_default
            default "0xa0000048 0x00000008 0b00000001" if Emu_Memory_Map_NZEA_NPC

    endmenu

    menu "SingleCycle Regions"

        config Emu_Sc_MEM_PSRAM
            string "Emu PSRAM Region"
            default "0x80000000 0x08000000 0b00000111"

        config Emu_Sc_MEM_SRAM
        depends on Emu_Memory_Map_NZEA_YSYXSOC
            string "Emu SRAM Region"
            default "0x0f000000 0x00002000 0b00000111"

        config Emu_Sc_MEM_MROM
        depends on Emu_Memory_Map_NZEA_YSYXSOC
            string "Emu MROM Region"
            default "0x20000000 0x00001000 0b00000101"

        config Emu_Sc_MEM_FLASH
        depends on Emu_Memory_Map_NZEA_YSYXSOC
            string "Emu FLASH Region"
            default "0x30000000 0x10000000 0b00000111"

        config Emu_Sc_MEM_SDRAM
        depends on Emu_Memory_Map_NZEA_YSYXSOC
            string "Emu SDRAM Region"
            default "0xa0000000 0x02000000 0b00000111"

        config Emu_Sc_MEM_Chip
        depends on Emu_Memory_Map_NZEA_YSYXSOC
            string "Emu Chip Region"
            default "0xc0000000 0x00020000 0b00000011"

        config Emu_Sc_DEV_Serial
            string "Emu Serial Region"
            default "0x100003f8 0x00000004 0b00000011" if Emu_Memory_Map_Emu_default
            default "0x10000000 0x00000004 0b00000011" if Emu_Memory_Map_NZEA_NPC

        config Emu_Sc_DEV_Timer
            string "Emu Timer Region"
            default "0x10000048 0x00000008 0b00000001" if Emu_Memory_Map_Emu_default
            default "0xa0000048 0x00000008 0b00000001" if Emu_Memory_Map_NZEA_NPC

    endmenu
endmenu
```

## config/dynamic/region/nzea/Kconfig
```kconfig
menu "Nzea Platform"
    menu "Ysyxsoc Memory Regions"

        config Nzea_Ysyxsoc_MEM_SRAM
            string "EMU SRAM Base Region"
            default "0x0f000000 0x00002000 0b00000111"
            help
                Region for EMU platform's SRAM.

        config Nzea_Ysyxsoc_MEM_MROM
            string "EMU MROM Base Region"
            default "0x20000000 0x00001000 0b00000101"
            help
                Region for EMU platform's MROM.

        config Nzea_Ysyxsoc_MEM_VGA
            string "EMU VGA Base Region"
            default "0x21000000 0x00200000 0b00000011"
            help
                Region for EMU platform's VGA.

        config Nzea_Ysyxsoc_MEM_FLASH
            string "EMU FLASH Base Region"
            default "0x30000000 0x10000000 0b00000111"
            help
                Region for EMU platform's FLASH.

        config Nzea_Ysyxsoc_MEM_PSRAM
            string "EMU PSRAM Base Region"
            default "0x80000000 0x00400000 0b00000111"
            help
                Region for EMU platform's PSRAM.

        config Nzea_Ysyxsoc_MEM_SDRAM
            string "EMU SDRAM Base Region"
            default "0xa0000000 0x02000000 0b00000111"
            help
                Region for EMU platform's SDRAM.

    endmenu

    menu "Npc Memory Regions"

        config Nzea_Npc_MEM_SDRAM
            string "Nzea Npc SRAM Base Region"
            default "0x80000000 0x08000000 0b00000111"

        config Nzea_Npc_MEM_LSRAM
            string "Nzea Npc LSRAM Base Region"
            default "0xb0000000 0x00020000 0b00000111"
        
    endmenu

    menu "jyd Regions"

        config Nzea_Jyd_MEM_IROM
            string "Nzea Jyd IROM Base Region"
            default "0x80000000 0x00004000 0b00000111"

        config Nzea_Jyd_MEM_DRAM
            string "Nzea Jyd DRAM Base Region"
            default "0x80100000 0x00080000 0b00000011"

    endmenu

    menu "jyd remote Regions"

        config Nzea_JydRemote_MEM_IROM
            string "Nzea JydRemote IROM Base Region"
            default "0x80000000 0x00004000 0b00000111"

        config Nzea_JydRemote_MEM_DRAM
            string "Nzea JydRemote DRAM Base Region"
            default "0x80100000 0x00080000 0b00000011"

    endmenu
endmenu
```

## config/region/Kconfig
```kconfig
menu "Regions"
    source "region/emu/Kconfig"

    source "region/nzea/Kconfig"
endmenu
```

## config/region/emu/Kconfig
```kconfig
menu "EMU Platform"
    choice
        prompt "EMU Memory Map"
        default EMU_Memory_Map_EMU_default

    config EMU_Memory_Map_EMU_default
        bool "EMU_default"

    config EMU_Memory_Map_NZEA_NPC
        bool "NZEA_NPC"

    config EMU_Memory_Map_NZEA_YSYXSOC
        bool "NZEA_YSYXSOC"
            
    endchoice

    menu "DirectlyMap Regions"

        config EMU_DM_MEM_PSRAM
            string "EMU PSRAM Region"
            default "0x80000000 0x00400000 0b00000111"

        config EMU_DM_MEM_SRAM
        depends on EMU_Memory_Map_NZEA_YSYXSOC
            string "EMU SRAM Region"
            default "0x0f000000 0x00002000 0b00000111"

        config EMU_DM_MEM_MROM
        depends on EMU_Memory_Map_NZEA_YSYXSOC
            string "EMU MROM Region"
            default "0x20000000 0x00001000 0b00000101"

        config EMU_DM_MEM_FLASH
        depends on EMU_Memory_Map_NZEA_YSYXSOC
            string "EMU FLASH Region"
            default "0x30000000 0x10000000 0b00000111"

        config EMU_DM_MEM_SDRAM
        depends on EMU_Memory_Map_NZEA_YSYXSOC
            string "EMU SDRAM Region"
            default "0xa0000000 0x02000000 0b00000111"

        config EMU_DM_MEM_Chip
        depends on EMU_Memory_Map_NZEA_YSYXSOC
            string "EMU Chip Region"
            default "0xc0000000 0x00020000 0b00000011"

        config EMU_DM_DEV_Serial
            string "EMU Serial Region"
            default "0x100003f8 0x00000004 0b00000011" if EMU_Memory_Map_EMU_default
            default "0x10000000 0x00000004 0b00000011" if EMU_Memory_Map_NZEA_NPC

        config EMU_DM_DEV_Timer
            string "EMU Timer Region"
            default "0x10000048 0x00000008 0b00000001" if EMU_Memory_Map_EMU_default
            default "0xa0000048 0x00000008 0b00000001" if EMU_Memory_Map_NZEA_NPC

    endmenu

    menu "SingleCycle Regions"

        config EMU_SC_MEM_PSRAM
            string "EMU PSRAM Region"
            default "0x80000000 0x00400000 0b00000111"

        config EMU_SC_MEM_SRAM
        depends on EMU_Memory_Map_NZEA_YSYXSOC
            string "EMU SRAM Region"
            default "0x0f000000 0x00002000 0b00000111"

        config EMU_SC_MEM_MROM
        depends on EMU_Memory_Map_NZEA_YSYXSOC
            string "EMU MROM Region"
            default "0x20000000 0x00001000 0b00000101"

        config EMU_SC_MEM_FLASH
        depends on EMU_Memory_Map_NZEA_YSYXSOC
            string "EMU FLASH Region"
            default "0x30000000 0x10000000 0b00000111"

        config EMU_SC_MEM_SDRAM
        depends on EMU_Memory_Map_NZEA_YSYXSOC
            string "EMU SDRAM Region"
            default "0xa0000000 0x02000000 0b00000111"

        config EMU_SC_MEM_Chip
        depends on EMU_Memory_Map_NZEA_YSYXSOC
            string "EMU Chip Region"
            default "0xc0000000 0x00020000 0b00000011"

        config EMU_SC_DEV_Serial
            string "EMU Serial Region"
            default "0x100003f8 0x00000004 0b00000011" if EMU_Memory_Map_EMU_default
            default "0x10000000 0x00000004 0b00000011" if EMU_Memory_Map_NZEA_NPC

        config EMU_SC_DEV_Timer
            string "EMU Timer Region"
            default "0x10000048 0x00000008 0b00000001" if EMU_Memory_Map_EMU_default
            default "0xa0000048 0x00000008 0b00000001" if EMU_Memory_Map_NZEA_NPC

    endmenu
endmenu
```
