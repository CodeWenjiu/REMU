## config/region/nzea/Kconfig
```kconfig
menu "NZEA Platform"
    menu "YSYXSOC Memory Regions"

        config NZEA_YSYXSOC_MEM_SRAM
            string "EMU SRAM Base Region"
            default "0x0f000000 0x00002000 0b00000111"
            help
                Region for EMU platform's SRAM.

        config NZEA_YSYXSOC_MEM_MROM
            string "EMU MROM Base Region"
            default "0x20000000 0x00001000 0b00000101"
            help
                Region for EMU platform's MROM.

        config NZEA_YSYXSOC_MEM_VGA
            string "EMU VGA Base Region"
            default "0x21000000 0x00200000 0b00000011"
            help
                Region for EMU platform's VGA.

        config NZEA_YSYXSOC_MEM_FLASH
            string "EMU FLASH Base Region"
            default "0x30000000 0x10000000 0b00000111"
            help
                Region for EMU platform's FLASH.

        config NZEA_YSYXSOC_MEM_PSRAM
            string "EMU PSRAM Base Region"
            default "0x80000000 0x00400000 0b00000111"
            help
                Region for EMU platform's PSRAM.

        config NZEA_YSYXSOC_MEM_SDRAM
            string "EMU SDRAM Base Region"
            default "0xa0000000 0x02000000 0b00000111"
            help
                Region for EMU platform's SDRAM.

    endmenu

    menu "NPC Memory Regions"

        config NZEA_NPC_MEM_SDRAM
            string "NZEA NPC SRAM Base Region"
            default "0x80000000 0x08000000 0b00000111"
        
    endmenu

    menu "jyd remote Regions"

        config NZEA_JydRemote_MEM_IROM
            string "NZEA JydRemote IROM Base Region"
            default "0x80000000 0x00004000 0b00000111"

        config NZEA_JydRemote_MEM_DRAM
            string "NZEA JydRemote DRAM Base Region"
            default "0x80100000 0x00040000 0b00000011"

    endmenu
endmenu
```

## config/static/Kconfig
```kconfig
mainmenu "REMU Static Configuratuion Menu"

config ITRACE
    bool "Static Itrace Enable"
    default y

config LOG
    bool "Enable Log to File"
    default n
```
